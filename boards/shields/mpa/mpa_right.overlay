

&default_transform {
    col-offset = <6>;
};

 kscan0: kscan {
         compatible     = "zmk,kscan-gpio-matrix";
         diode-direction = "col2row";
         wakeup-source;

         row-gpios =
               <&pro_micro 5 (GPIO_ACTIVE_HIGH | GPIO_PULL_DOWN)> // row1
             , <&pro_micro 8 (GPIO_ACTIVE_HIGH | GPIO_PULL_DOWN)> // row2
             , <&pro_micro 10 (GPIO_ACTIVE_HIGH | GPIO_PULL_DOWN)> // row3
             , <&pro_micro 18 (GPIO_ACTIVE_HIGH | GPIO_PULL_DOWN)> // row4
             ;

&kscan0 {
    col-gpios
        = <&pro_micro 6 GPIO_ACTIVE_HIGH> // col7
        , <&pro_micro 7 GPIO_ACTIVE_HIGH> // col8
        , <&pro_micro 15 GPIO_ACTIVE_HIGH> // col9
        , <&pro_micro 16 GPIO_ACTIVE_HIGH> // col10
        , <&pro_micro 9 GPIO_ACTIVE_HIGH> // col11
        , <&pro_micro 14 GPIO_ACTIVE_HIGH> // col12
        ;
};
