

 kscan0: kscan {
         compatible     = "zmk,kscan-gpio-matrix";
         diode-direction = "col2row";
         wakeup-source;

         row-gpios =
               <&pro_micro 4 (GPIO_ACTIVE_HIGH | GPIO_PULL_DOWN)> // row1
             , <&pro_micro 15 (GPIO_ACTIVE_HIGH | GPIO_PULL_DOWN)> // row2
             , <&pro_micro 9 (GPIO_ACTIVE_HIGH | GPIO_PULL_DOWN)> // row3
             , <&pro_micro 8 (GPIO_ACTIVE_HIGH | GPIO_PULL_DOWN)> // row4
             ;

&kscan0 {
    col-gpios
        = <&pro_micro 21 GPIO_ACTIVE_HIGH> // col1
        , <&pro_micro 10 GPIO_ACTIVE_HIGH> // col2
        , <&pro_micro 16 GPIO_ACTIVE_HIGH> // col3
        , <&pro_micro 14 GPIO_ACTIVE_HIGH> // col4
        , <&pro_micro 20 GPIO_ACTIVE_HIGH> // col5
        , <&pro_micro 19 GPIO_ACTIVE_HIGH> // col6
        ;
};
